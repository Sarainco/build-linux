## build-embedded-system/Config.in
```kconfig
mainmenu "Build System Configuration"

menu "Generic options"

config ARCH
	string
	default "arm" if ARM
	default "arm64" if ARM64
	default "x86" if X86

choice
	prompt "ARCH"
	default ARM

config ARM
	bool "arm"

config ARM64
	bool "arm64"

config X86
	bool "x86"

endchoice

config DL_DIR
	string "dl directory"
	default "~/dl"

endmenu

source toolchain/Config.in
source package/Config.in
```

## build-embedded-system/kernel/Config.in
```kconfig
menu "Kernel options"

config KERNEL
	bool "Kernel support"
	default y if !X86

if KERNEL

config KERNEL_VER
	string
	default "5.10" if KERNEL_5_10

choice
	prompt "kernel version"


config KERNEL_ROCKCHIP_5_10
	bool "kernel-rockchip-5.10"

config KERNEL_KICKPI_5_10
	bool "kernel-kickpi-5.10"


endchoice


endif

endmenu
```

## build-embedded-system/package/Config.in
```kconfig
menu "package Build"

menuconfig PACKAGE_BUSYBOX
	bool "busybox"
	default y

menuconfig PACKAGE_UTIL_LINUX
	bool "util-linux"
	default y

endmenu
```

## build-embedded-system/toolchain/Config.in
```kconfig
menu "Toolchain options"

config TOOLCHAIN
	bool "Toolchain support"
	default y if !X86

if TOOLCHAIN

config TOOLCHAIN_DIR
	string "toolchain dir"
	default "~/workspace/toolchain"

config TOOLCHAIN_NAME
	string "toolchain name"
	help
		define toolchain dir $TOOLCHAIN_DIR/$CONFIG_TOOLCHAIN_NAME

config TOOLCHAIN_TARGET
	string "toolchain target"
	help
		toolchain target e.g. arm-linux-gnueabihf

endif

endmenu
```

## configs/rockchip_rk3568_defconfig
```kconfig
#include "base.config"
#include "base_extra.config"
#include "camera.config"
#include "debug.config"
#include "weston.config"
#include "gpu.config"
#include "powermanager.config"
#include "rk356x_arm64.config"
BR2_KERNEL_MIRROR="https://mirror.bjtu.edu.cn/kernel/"
BR2_GNU_MIRROR="http://mirrors.nju.edu.cn/gnu/"
BR2_LUAROCKS_MIRROR="https://luarocks.cn"
BR2_CPAN_MIRROR="http://mirrors.nju.edu.cn/CPAN/"
BR2_TARGET_GENERIC_HOSTNAME="vs"
BR2_TARGET_GENERIC_ISSUE="Welcome to vs"
BR2_PACKAGE_RKNPU2=y
BR2_PACKAGE_GDB=y
BR2_PACKAGE_GDB_DEBUGGER=y
```

## rockchip-linux-build/buildroot/rockchip_rk3568_defconfig
```kconfig
#include "base.config"
#include "base_extra.config"
#include "camera.config"
#include "debug.config"
#include "weston.config"
#include "gpu.config"
#include "powermanager.config"
#include "rk356x_arm64.config"
BR2_KERNEL_MIRROR="https://mirror.bjtu.edu.cn/kernel/"
BR2_GNU_MIRROR="http://mirrors.nju.edu.cn/gnu/"
BR2_LUAROCKS_MIRROR="https://luarocks.cn"
BR2_CPAN_MIRROR="http://mirrors.nju.edu.cn/CPAN/"
BR2_TARGET_GENERIC_HOSTNAME="vs"
BR2_TARGET_GENERIC_ISSUE="Welcome to vs800"
BR2_PACKAGE_RKNPU2=y
BR2_PACKAGE_XZ=y
BR2_PACKAGE_GDB=y
BR2_PACKAGE_GDB_DEBUGGER=y
BR2_PACKAGE_SQLITE=y
BR2_PACKAGE_HARFBUZZ=y
BR2_PACKAGE_OPENCV4=y
BR2_PACKAGE_OPENCV4_LIB_SHAPE=y
BR2_PACKAGE_OPENCV4_LIB_STITCHING=y
BR2_PACKAGE_OPENCV4_LIB_SUPERRES=y
BR2_PACKAGE_OPENCV4_LIB_TS=y
BR2_PACKAGE_OPENCV4_LIB_VIDEOSTAB=y
BR2_PACKAGE_OPENCV4_WITH_FFMPEG=y
BR2_PACKAGE_OPENCV4_WITH_GSTREAMER1=y
BR2_PACKAGE_OPENCV4_WITH_JPEG=y
BR2_PACKAGE_OPENCV4_WITH_PNG=y
BR2_PACKAGE_OPENCV4_WITH_PROTOBUF=y
BR2_PACKAGE_OPENCV4_WITH_TIFF=y
BR2_PACKAGE_OPENCV4_WITH_V4L=y
BR2_PACKAGE_OPENCV4_WITH_WEBP=y
BR2_PACKAGE_OPENCV4_LIB_FREETYPE=y
BR2_PACKAGE_MPDECIMAL=y
```
